## src/drivers/distance_sensor/tr24da100/Kconfig
```kconfig
menuconfig DRIVERS_DISTANCE_SENSOR_TR24DA100
	bool "tr24da100"
	default n
	---help---
		Enable support for tr24da100
```

## src/modules/flktr2l/Kconfig
```kconfig
menuconfig MODULES_FLKTR2L
	bool "flktr2l"
	default n
	---help---
		Enable support for flktr2l

menuconfig USER_FLKTR2L
	bool "flktr2l running as userspace module"
	default n
	depends on MODULES_FLKTR2L
	---help---
		Put flktr2l in userspace memory
```

## src/modules/tooldrv/Kconfig
```kconfig
menuconfig MODULES_TOOLDRV
	bool "tooldrv"
	default n
	---help---
		Enable support for Fluktor drones

menuconfig USER_TOOLDRV
	bool "tooldrv running as userspace module"
	default n
	depends on MODULES_TOOLDRV
	---help---
		Put tooldrv in userspace memory
```
